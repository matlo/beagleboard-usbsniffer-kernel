## drivers/media/video/isp/Kconfig
```kconfig
# Kconfig for OMAP3 ISP driver

config VIDEO_OMAP3_ISP
	bool
	select VIDEOBUF_GEN
	select VIDEOBUF_DMA_SG
	select OMAP_IOMMU

config VIDEO_OMAP34XX_ISP_PREVIEWER
	tristate "OMAP ISP Previewer"
	depends on !ARCH_OMAP3410
	select VIDEO_OMAP3_ISP


config VIDEO_OMAP34XX_ISP_RESIZER
	tristate "OMAP ISP Resizer"
	depends on !ARCH_OMAP3410
	select VIDEO_OMAP3_ISP
```

## drivers/media/video/ti-media/Kconfig
```kconfig
config TI_MEDIA
	tristate "TI Media Drivers"
	depends on VIDEO_V4L2 && (ARCH_OMAP || ARCH_DAVINCI)
	default n
	---help---
	  Video Drivers for all TI devices, like OMAP, Davinci, etc...

config DISPLAY_DAVINCI_DM646X_EVM
	tristate "DM646x EVM Video Display"
	depends on TI_MEDIA && MACH_DAVINCI_DM6467_EVM
	select VIDEOBUF_DMA_CONTIG
	select VIDEO_DAVINCI_VPIF
	select VIDEO_ADV7343
	select VIDEO_THS7303
	help
	  Support for DM6467 based display device.

	  To compile this driver as a module, choose M here: the
	  module will be called vpif_display.

config VIDEO_DAVINCI_VPIF
	tristate "DaVinci VPIF Driver"
	depends on DISPLAY_DAVINCI_DM646X_EVM
	help
	  Support for DaVinci VPIF Driver.

	  To compile this driver as a module, choose M here: the
	  module will be called vpif.

config CAPTURE_DAVINCI_DM646X_EVM
	tristate "DM646x EVM Video Capture"
	depends on TI_MEDIA && MACH_DAVINCI_DM6467_EVM
	select VIDEOBUF_DMA_CONTIG
	select VIDEO_DAVINCI_VPIF
	help
	  Support for DM6467 based capture device.

	  To compile this driver as a module, choose M here: the
	  module will be called vpif_capture.

config VIDEO_VPSS_SYSTEM
	tristate "VPSS System module driver"
	depends on TI_MEDIA
	default y
	help
	  Support for vpss system module for video driver

config VIDEO_VPFE_CAPTURE
	tristate "VPFE Video Capture Driver"
	depends on TI_MEDIA
	select VIDEOBUF_DMA_CONTIG
	help
	  Support for DMXXXX VPFE based frame grabber. This is the
	  common V4L2 module for following DMXXX SoCs from Texas
	  Instruments:- DM6446 & DM355.

	  To compile this driver as a module, choose M here: the
	  module will be called vpfe-capture.

config VIDEO_DM6446_CCDC
	tristate "DM6446 CCDC HW module"
	depends on VIDEO_VPFE_CAPTURE
	select VIDEO_VPSS_SYSTEM
	default y
	help
	   Enables DaVinci CCD hw module. DaVinci CCDC hw interfaces
	   with decoder modules such as TVP5146 over BT656 or
	   sensor module such as MT9T001 over a raw interface. This
	   module configures the interface and CCDC/ISIF to do
	   video frame capture from slave decoders.

	   To compile this driver as a module, choose M here: the
	   module will be called vpfe.

config VIDEO_DM355_CCDC
	tristate "DM355 CCDC HW module"
	depends on VIDEO_VPFE_CAPTURE
	select VIDEO_VPSS_SYSTEM
	default y
	help
	   Enables DM355 CCD hw module. DM355 CCDC hw interfaces
	   with decoder modules such as TVP5146 over BT656 or
	   sensor module such as MT9T001 over a raw interface. This
	   module configures the interface and CCDC/ISIF to do
	   video frame capture from a slave decoders

	   To compile this driver as a module, choose M here: the
	   module will be called vpfe.

config VIDEO_OMAP2_VOUT
	tristate "OMAP2/OMAP3 V4L2-DSS driver"
	select VIDEOBUF_GEN
	select VIDEOBUF_DMA_SG
	select OMAP2_DSS
	select OMAP2_VRAM
	select OMAP2_VRFB
	depends on TI_MEDIA && (ARCH_OMAP24XX || ARCH_OMAP34XX)
	default y
	---help---
	  V4L2 DSS support for OMAP2/3 based boards.
```
